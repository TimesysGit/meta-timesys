## conf/layer.conf
```bitbake
# We have a conf and classes directory, add to BBPATH
BBPATH .= ":${LAYERDIR}"

BBFILES += "${LAYERDIR}/recipes-*/*/*.bb \
            ${LAYERDIR}/recipes-*/*/*.bbappend"

BBFILE_COLLECTIONS += "timesys"
BBFILE_PRIORITY_timesys = "5"
BBFILE_PATTERN_timesys := "^${LAYERDIR}/"


###
# - COMPAT set to whinlatter
#   since there should be no discrepancies between those versions WRT anything we do.
###
LAYERSERIES_COMPAT_timesys = "whinlatter"


### 
# - LAYERDIR is only accurate when this file is parsed, so 
#   we set VIGILES_LAYERDIR here for later use.
###
VIGILES_LAYERDIR := "${LAYERDIR}"

addpylib ${LAYERDIR}/lib tsmeta
```
